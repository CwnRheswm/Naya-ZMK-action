## Kconfig
```kconfig
config NAYA_CTRL
    bool "Naya control commands on a USB serial port (for the Naya Control app)"
    select SERIAL
    select UART_INTERRUPT_DRIVEN
    select UART_LINE_CTRL
    select USB_CDC_ACM
```

## dts/bindings/naya,led-overlay.yaml
```yaml
description: |
  Pass-through LED strip used as zmk,underglow. Every frame from the underglow is copied,
  the Bluetooth-slot key is painted white (see led_overlay.c), and the result goes to led-strip.
compatible: "naya,led-overlay"
include: base.yaml
properties:
  led-strip:
    type: phandle
    required: true
    description: The real LED strip.
  chain-length:
    type: int
    required: true
    description: Number of LEDs (same as the real strip; ZMK's underglow reads it from here).
```

## dts/bindings/naya,module-input.yaml
```yaml
description: |
  Input device fed by naya_ctrl.c with decoded touch-module / dial events
  received from a Naya module on the module UART.
compatible: "naya,module-input"
include: base.yaml
```
